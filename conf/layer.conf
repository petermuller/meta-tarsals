## conf/layer.conf
```bitbake
# We have a conf and classes directory, append to BBPATH
BBPATH .= ":${LAYERDIR}"

# We have a recipes directory containing .bb and .bbappend files, add to BBFILES
BBFILES += "${LAYERDIR}/recipes*/*/*.bb \
            ${LAYERDIR}/recipes*/*/*.bbappend"

BBFILE_COLLECTIONS += "tarsals"
BBFILE_PATTERN_tarsals := "^${LAYERDIR}/"
BBFILE_PRIORITY_tarsals = "7"

# Additional license directories.
LICENSE_PATH += "${LAYERDIR}/files/licenses"
```
